#include <SPI.h>
#include "printf.h"
#include "RF24.h"
#include "ssd1306.h"

#define CE_PIN 7
#define CSN_PIN 8

#define BUTTON_BACK 2
#define BUTTON_SHORTCUT1 3
#define BUTTON_SHORTCUT2 4
#define BUTTON_UP A1
#define BUTTON_LEFT 6
#define BUTTON_SEL 5
#define BUTTON_DOWN 10
#define BUTTON_RIGHT A6
#define BUTTON_POWER A7

// instantiate an object for the nRF24L01 transceiver
RF24 radio(CE_PIN, CSN_PIN);

// Let these addresses be used for the pair
uint8_t address[][6] = { "1Node", "2Node" };
// It is very helpful to think of an address as a path instead of as
// an identifying device destination

// to use different addresses on a pair of radios, we need a variable to
// uniquely identify which address this radio will use to transmit

// Used to control whether this node is sending or receiving
bool role = false;  // true = TX role, false = RX role

// For this example, we'll be using a payload containing
// a single float number that will be incremented
// on every successful transmission
// char payload[] = "hello world";
float payload;

const uint8_t Owl [] PROGMEM = {
0x00, 0x00, 0x00, 0x00, 0x00, 0x00, 0x00, 0x00, 0x00, 0x00, 0x00, 0x00, 0x00, 0x00, 0x00, 0x00,
0x00, 0x00, 0x00, 0x00, 0x00, 0x00, 0x00, 0x00, 0x00, 0x00, 0x00, 0x00, 0x00, 0x00, 0x00, 0x00,
0x00, 0x00, 0x00, 0x00, 0x00, 0x00, 0x00, 0x00, 0x00, 0x00, 0x00, 0x00, 0x00, 0x00, 0x00, 0x00,
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0x00, 0x00, 0x00, 0x00, 0x00, 0x00, 0x00, 0x00, 0x00, 0x00, 0x00, 0x00, 0x00, 0x00, 0x00, 0x00
};

void setup() {
  Serial.begin(115200);
    ssd1306_128x64_i2c_initEx(-1, -1, 0x3D);
    ssd1306_clearScreen( );
    ssd1306_drawBitmap(0, 0, 128, 64, Owl);
    delay(1000);
    ssd1306_128x64_i2c_initEx(-1, -1, 0x3C);
    ssd1306_clearScreen( );
    ssd1306_drawBitmap(0, 0, 128, 64, Owl);

  while (!Serial) {
    // some boards need to wait to ensure access to serial over USB
  }

  // initialize the transceiver on the SPI bus
  if (!radio.begin()) {
    Serial.println(F("radio hardware is not responding!!"));
    while (1) {}  // hold in infinite loop
  }

  // print example's introductory prompt
  Serial.println(F("RF24/examples/GettingStarted"));

  // To set the radioNumber via the Serial monitor on startup

  bool radioNumber = 1;
  Serial.print(F("radioNumber = "));
  Serial.println((int)radioNumber);

  // role variable is hardcoded to RX behavior, inform the user of this
  Serial.println(F("*** PRESS 'T' to begin transmitting to the other node"));

  // Set the PA Level low to try preventing power supply related problems
  // because these examples are likely run with nodes in close proximity to
  // each other.
  radio.setPALevel(RF24_PA_LOW);  // RF24_PA_MAX is default.

  // save on transmission time by setting the radio to only transmit the
  // number of bytes we need to transmit a float
  radio.setPayloadSize(sizeof(payload));  // float datatype occupies 4 bytes

  // set the TX address of the RX node into the TX pipe
  radio.openWritingPipe(address[radioNumber]);  // always uses pipe 0

  // set the RX address of the TX node into a RX pipe
  radio.openReadingPipe(1, address[!radioNumber]);  // using pipe 1

  // additional setup specific to the node's role
  if (role) {
    radio.stopListening();  // put radio in TX mode
  } else {
    radio.startListening();  // put radio in RX mode
  }
    pinMode(BUTTON_BACK, INPUT_PULLUP);
    pinMode(BUTTON_SHORTCUT1, INPUT_PULLUP);
    pinMode(BUTTON_SHORTCUT2, INPUT_PULLUP);
    pinMode(BUTTON_UP, INPUT_PULLUP);
    pinMode(BUTTON_LEFT, INPUT_PULLUP);
    pinMode(BUTTON_SEL, INPUT_PULLUP);
    pinMode(BUTTON_DOWN, INPUT_PULLUP);
    pinMode(BUTTON_RIGHT, INPUT_PULLUP);
    pinMode(BUTTON_POWER, INPUT_PULLUP);
}  // setup

void loop() {
    // Working buttons are power, back, left, right, shortcut 1, shortcut 2
    if (digitalRead(BUTTON_SEL) == 0){
    Serial.println("Select button pressed");
    payload = 0.02;
    }
    else if (digitalRead(BUTTON_BACK) == LOW){
    Serial.println("Back button pressed");
    payload = 2.00;
    }
    else if (digitalRead(BUTTON_SHORTCUT1) == LOW){
    Serial.println("Shortcut button 1 pressed");
    payload = 5.00;
    }
    else if (digitalRead(BUTTON_SHORTCUT2) == LOW){
    Serial.println("Shortcut button 2 pressed");
    payload = 6.00;
    }
    else if (digitalRead(BUTTON_UP) == LOW){
    // Serial.println("Up button pressed");
    // payload = 0.02;
    }
    else if (digitalRead(BUTTON_LEFT) == LOW){
    Serial.println("Left button pressed");
    payload = 3.00;
    }
    else if (analogRead(BUTTON_DOWN) == 0){
    // Serial.println("Down button pressed");
    // payload = 0.02;
    }
    else if (analogRead(BUTTON_RIGHT) == 0){
    Serial.println("Right button pressed");
    payload = 4.00;
    }
    else if (analogRead(BUTTON_POWER) == 0){
    Serial.println("Power button pressed");
    payload = 1.00;
    } else{
    payload = 0.00;
    }


  if (role) {
    // This device is a TX node

    unsigned long start_timer = micros();                // start the timer
    bool report = radio.write(&payload, sizeof(payload));  // transmit & save the report
    unsigned long end_timer = micros();                  // end the timer

    if (report) {
      Serial.print(F("Transmission successful! "));  // payload was delivered
      Serial.print(F("Time to transmit = "));
      Serial.print(end_timer - start_timer);  // print the timer result
      Serial.print(F(" us. Sent: "));

      Serial.println(payload);  // print payload sent
    } else {
      Serial.println(F("Transmission failed or timed out"));  // payload was not delivered
    }

    // to make this example readable in the serial monitor
    delay(100);  // slow transmissions down by 1 second

  } else {
    // This device is a RX node

    uint8_t pipe;
    if (radio.available(&pipe)) {              // is there a payload? get the pipe number that recieved it
      uint8_t bytes = radio.getPayloadSize();  // get the size of the payload
      radio.read(&payload, bytes);             // fetch payload from FIFO
      Serial.print(F("Received "));
      Serial.print(bytes);  // print the size of the payload
      Serial.print(F(" bytes on pipe "));
      Serial.print(pipe);  // print the pipe number
      Serial.print(F(": "));
      Serial.println(payload);  // print the payload's value
    }
  }  // role

  if (Serial.available()) {
    // change the role via the serial monitor

    char c = toupper(Serial.read());
    if (c == 'T' && !role) {
      // Become the TX node

      role = true;
      Serial.println(F("*** CHANGING TO TRANSMIT ROLE -- PRESS 'R' TO SWITCH BACK"));
      radio.stopListening();

    } else if (c == 'R' && role) {
      // Become the RX node

      role = false;
      Serial.println(F("*** CHANGING TO RECEIVE ROLE -- PRESS 'T' TO SWITCH BACK"));
      radio.startListening();
    }
  }

}  // loop
